## config/west.yml
```yaml
manifest:
  remotes:
    - name: urob
      url-base: https://github.com/urob
    - name: petejohanson
      url-base: https://github.com/petejohanson
  projects:
    - name: zmk
      remote: petejohanson
      revision: feat/pointers-move-scroll
      import: app/west.yml    - name: zmk-helpers
      revision: main
      path: modules/helpers
    - name: zmk-auto-layer
      revision: main
      path: modules/auto-layer
    - name: zmk-tri-state
      revision: main
      path: modules/tri-state
      
  self:
    path: config
```
